## Examples/Linux.Build_RV32i/doom-puredoom/Config.in
```kconfig
config BR2_PACKAGE_DOOM_PUREDOOM
	bool "doom-puredoom"
	select BR2_PACKAGE_DOOM_WAD
	help
	  Doom port using PureDOOM (single-header, MIT). Replaces the older
	  doomgeneric port. Talks directly to the rvemu MMIO peripherals via
	  /dev/mem:
	    - 320x200 RGBA → 2x-upscaled, centered in 1024x768 framebuffer
	      at 0x85C00000
	    - keyboard FIFO at 0x10001000, mouse at 0x10002000
	    - audio PCM buffer at 0x30000000 (sound effects)
	    - MIDI short messages at 0x10005004 (music)

	  Selects doom-wad which installs the shareware WAD at
	  /usr/share/games/doom/doom1.wad.

	  PureDOOM source is bundled in-tree at
	  Examples/Doom/Programs/PureDOOM.h.
```

## RiscVEmulator-RV6/Examples/Linux.Build_RV32i/doomgeneric/Config.in
```kconfig
config BR2_PACKAGE_DOOMGENERIC
	bool "doomgeneric"
	select BR2_PACKAGE_DOOM_WAD
	help
	  Pure-C portable Doom port. Renders into a generic
	  callback-based frontend — we ship an rvemu backend that
	  draws directly to /dev/mem at 0x85C00000 (3x upscaled,
	  centered on the 1024x768 framebuffer) and reads input from
	  /dev/input/event0.

	  Selects doom-wad which installs the shareware WAD at
	  /usr/share/games/doom/doom1.wad.

	  https://github.com/ozkl/doomgeneric
```
