## RiscVEmulator-RV32I/Examples/Linux.Build_RV32i/tyrquake/Config.in
```kconfig
config BR2_PACKAGE_TYRQUAKE
	bool "tyrquake"
	help
	  Quake (TyrQuake software-rendered port) for the rvemu nommu RV32
	  Linux guest. Renders to /dev/mem at 0x85C00000 (the same surface
	  doom-puredoom and rvemu-fbtest use), reads keyboard/mouse from
	  /dev/input/event{0,1}, and pipes audio through rvemu-audiod.

	  Ships the shareware id1/pak0.pak (~18 MiB, freely redistributable
	  per id Software's terms). After install:

	    # /usr/bin/quake             ← user-facing wrapper
	    # /usr/libexec/quake         ← real binary
	    # /usr/share/games/quake/id1/pak0.pak

	  Expect single-digit FPS without an F-extension — every float op
	  in the BSP traversal and span renderer becomes a softfloat libcall.

	  Source: https://github.com/sezero/tyrquake (vendored separately
	  for the bare-metal Examples/Quake; the Linux package re-uses
	  the same tree).
```
